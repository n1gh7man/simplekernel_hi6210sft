## arch/arm64/hotplug/Kconfig
```kconfig
config THUNDERPLUG_CONTROL
	bool "Enable plugging down/up of cores based on load per core"
	help
	  This driver hotplugs cpu cores based on per-core load

config INTELLI_PLUG
        bool "Enable intelli-plug cpu hotplug driver"
        default n
        help
          Generic Intelli-plug cpu hotplug driver for ARM SOCs
```

## arch/arm64/hotplug/autosmp/Kconfig
```kconfig
config ASMP
    bool "Multi-core automatic hotplug support"
    depends on SMP
    default n
    help
      Automatically hotplugs the multiple cpu cores on and off
      based on cpu load and suspend state

config POWERSUSPEND_NEW
    bool "New powersuspend"
    depends on ASMP && POWERSUSPEND
    default y
```

## arch/arm64/hotplug/intelli_plug/Kconfig
```kconfig
config INTELLI_PLUG
        bool "Enable intelli-plug cpu hotplug driver"
        default y
        help
          Generic Intelli-plug cpu hotplug driver for ARM SOCs

config INTELLI_PLUG_CPUS
	int "Maximum number of CPUs (4 or 8) (expremental)"
	range 4 8
	depends on INTELLI_PLUG
	default "8"

config INTELLI_PLUG_PERF_BOOST
        bool "perf_boost sysfs entry"
	depends on INTELLI_PLUG
        default y
```
